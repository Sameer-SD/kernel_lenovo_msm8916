/* Copyright (c) 2014-2016, The Linux Foundation. All rights reserved.
 *
 * This program is free software; you can redistribute it and/or modify
 * it under the terms of the GNU General Public License version 2 and
 * only version 2 as published by the Free Software Foundation.
 *
 * This program is distributed in the hope that it will be useful,
 * but WITHOUT ANY WARRANTY; without even the implied warranty of
 * MERCHANTABILITY or FITNESS FOR A PARTICULAR PURPOSE.  See the
 * GNU General Public License for more details.
 */

&soc {
       qcom,mdss_dsi@1a98000 {
             qcom,ctrl-supply-entries {
                  qcom,ctrl-supply-entry@0 {
                          /delete-property/ qcom,supply-post-on-sleep;
                  };
             };
        };
};

#include "msm8939-common.dtsi"
#include "msm8939-pm.dtsi"
#include "msm8939-mdss.dtsi"
#include "msm-pm8916.dtsi"
#include "msm8939-regulator.dtsi"
#include "msm8939-qrd-wt82918.dtsi"
#include "msm8939-pinctrl.dtsi"
#include "msm8939-qrd.dtsi"
